## mruby/Config.in
```kconfig
menu "Binaries"
	depends on PACKAGE_mruby

config MRUBY_MRUBY
	bool "mruby interpreter"
	default y

config MRUBY_MRBC
	bool "mruby compiler"
	default n

config MRUBY_MIRB
	bool "mruby interactive shell"
	default y

config MRUBY_STRIP
	bool "mruby strip"
	default n

endmenu

menu "GEMs (Core)"
	depends on PACKAGE_mruby

config MRUBY_ARRAY_EXT
	bool "mruby-array-ext"
	default y

config MRUBY_ENUM_EXT
	bool "mruby-enum-ext"
	default y

config MRUBY_ENUM_LAZY
	bool "mruby-enum-lazy"
	default y

config MRUBY_ENUMERATOR
	bool "mruby-enumerator"
	default y

config MRUBY_ERROR
	bool "mruby-error"
	default y

config MRUBY_EVAL
	bool "mruby-eval"
	default y

config MRUBY_EXIT
	bool "mruby-exit"
	default y

config MRUBY_FIBER
	bool "mruby-fiber"
	default y

config MRUBY_HASH_EXT
	bool "mruby-hash-ext"
	default y

config CONFIG_MRUBY_KERNEL_EXT
	bool "mruby-kernel-ext"
	default y

config MRUBY_MATH
	bool "mruby-math"
	default y

config MRUBY_NUMERIC_EXT
	bool "mruby-numeric-ext"
	default y

config MRUBY_OBJECT_EXT
	bool "mruby-object-ext"
	default y

config MRUBY_OBJECTSPACE
	bool "mruby-objectspace"
	default y

config MRUBY_PRINT
	bool "mruby-print"
	default y

config MRUBY_PROC_EXT
	bool "mruby-proc-ext"
	default y

config MRUBY_RANDOM
	bool "mruby-random"
	default y

config MRUBY_RANGE_EXT
	bool "mruby-range-ext"
	default y

config MRUBY_SPRINTF
	bool "mruby-sprintf"
	default y

config MRUBY_STRING_EXT
	bool "mruby-string-ext"
	default y

config MRUBY_STRUCT
	bool "mruby-struct"
	default y

config MRUBY_SYMBOL_EXT
	bool "mruby-symbol-ext"
	default y

config MRUBY_TIME
	bool "mruby-time"
	default y

config MRUBY_TOPLEVEL_EXT
	bool "mruby-toplevel-ext"
	default y

endmenu

menu "GEMs (External)"
	depends on PACKAGE_mruby

config MRUBY_IO
	bool "mruby-io"
	default y

config MRUBY_SLEEP
	bool "mruby-sleep"
	default y

config MRUBY_SOCKET
	bool "mruby-socket"
	default y

config MRUBY_PROCESS
	bool "mruby-process"
	default y

config MRUBY_PACK
	bool "mruby-pack"
	default y

config MRUBY_ENV
	bool "mruby-env"
	default y

config MRUBY_DIR
	bool "mruby-dir"
	default y

config MRUBY_MRICK
	bool "mruby-mrick"
	default y

config MRUBY_BIGNUM
	bool "mruby-bignum"
	default y

config MRUBY_THREAD
	bool "mruby-thread"
	default y

endmenu
```
